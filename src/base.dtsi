// core ZMK includes
#include <behaviors.dtsi>
#include <dt-bindings/zmk/keys.h>
#include <dt-bindings/zmk/bt.h>
#include <dt-bindings/zmk/outputs.h>

// layers constants
#define BASE 0
#define NUM  1
#define SYM  2
#define NAV  3
#define NUMP 4

// MEH & HYPER keys
#define HYPER LS(LC(LA(LGUI)))
#define HYP(key) LS(LC(LA(LG(key))))
#define MEH(key) LS(LC(LA(key)))

// stringify macro
#define str(s) #s

// behaviors constants
#define TAPPING_TERM_MS 280
#define QUICK_TAP_MS 175
#define GLOBAL_QUICK_TAP_MS 150

// combos constants
#define COMBO_TERM_DEFAULT 30
#define COMBO_QUICK_TAP_MS 100

#include "macros.dtsi"
#include "behaviors.dtsi"
#include "combos.dtsi"

